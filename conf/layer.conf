## conf/layer.conf
```bitbake
# We have a conf and classes directory, add to BBPATH
BBPATH .= ":${LAYERDIR}"

# We have recipes-* directories, add to BBFILES
BBFILES += "${LAYERDIR}/recipes-*/*/*.bb \
            ${LAYERDIR}/recipes-*/*/*.bbappend"

BBFILE_COLLECTIONS += "my-mender-layer"
BBFILE_PATTERN_my-mender-layer = "^${LAYERDIR}/"
BBFILE_PRIORITY_my-mender-layer = "6"

LAYERDEPENDS_my-mender-layer = "core"
LAYERSERIES_COMPAT_my-mender-layer = "thud warrior"
```
